## configs/mangopi-mq-quad-cctv_defconfig
```kconfig
BR2_aarch64=y
BR2_KERNEL_HEADERS_6_1=y
BR2_GCC_VERSION_12_X=y
BR2_TOOLCHAIN_BUILDROOT_CXX=y
BR2_CCACHE=y
BR2_TARGET_GENERIC_HOSTNAME="mangopi"
BR2_TARGET_GENERIC_ISSUE="Welcome to MangoPi MQ-QUAD"
BR2_INIT_OPENRC=y
BR2_ROOTFS_DEVICE_CREATION_DYNAMIC_EUDEV=y
BR2_TARGET_GENERIC_ROOT_PASSWD="1"
BR2_ROOTFS_USERS_TABLES="$(BR2_EXTERNAL_MANGOPI_MQ_QUAD_PATH)/board/mangopi/users.txt"
BR2_ROOTFS_POST_IMAGE_SCRIPT="$(BR2_EXTERNAL_MANGOPI_MQ_QUAD_PATH)/board/mangopi/scripts/prepare_rootfs.sh"
BR2_ROOTFS_POST_SCRIPT_ARGS="${UBOOT_DIR}/u-boot.dtb $(BINARIES_DIR) support/scripts/genimage.sh -c $(BR2_EXTERNAL_MANGOPI_MQ_QUAD_PATH)/board/mangopi/configs/genimage.cfg"
BR2_LINUX_KERNEL=y
BR2_LINUX_KERNEL_CUSTOM_VERSION=y
BR2_LINUX_KERNEL_CUSTOM_VERSION_VALUE="6.1.8"
BR2_LINUX_KERNEL_PATCH="$(BR2_EXTERNAL_MANGOPI_MQ_QUAD_PATH)/board/mangopi/patches/kernel"
BR2_LINUX_KERNEL_USE_CUSTOM_CONFIG=y
BR2_LINUX_KERNEL_CUSTOM_CONFIG_FILE="$(BR2_EXTERNAL_MANGOPI_MQ_QUAD_PATH)/board/mangopi/configs/kernel.config"
BR2_LINUX_KERNEL_XZ=y
BR2_PACKAGE_LINUX_TOOLS_CPUPOWER=y
BR2_PACKAGE_LINUX_TOOLS_TMON=y
BR2_PACKAGE_GZIP=y
BR2_PACKAGE_XZ=y
BR2_PACKAGE_EXFAT=y
BR2_PACKAGE_EXFAT_UTILS=y
BR2_PACKAGE_EXFATPROGS=y
BR2_PACKAGE_ARMBIAN_FIRMWARE=y
BR2_PACKAGE_I2C_TOOLS=y
BR2_PACKAGE_LM_SENSORS=y
BR2_PACKAGE_LSHW=y
BR2_PACKAGE_LSSCSI=y
BR2_PACKAGE_POWERTOP=y
BR2_PACKAGE_RTL8723DS=y
BR2_PACKAGE_RTL8723DS_BT=y
BR2_PACKAGE_PYTHON3=y
BR2_PACKAGE_CA_CERTIFICATES=y
BR2_PACKAGE_LIBV4L=y
BR2_PACKAGE_LIBCURL_CURL=y
BR2_PACKAGE_DHCPCD=y
BR2_PACKAGE_OPENSSH=y
# BR2_PACKAGE_OPENSSH_CLIENT is not set
BR2_PACKAGE_WPA_SUPPLICANT=y
BR2_PACKAGE_HTOP=y
BR2_PACKAGE_LESS=y
BR2_PACKAGE_VIM=y
# BR2_PACKAGE_VIM_RUNTIME is not set
BR2_TARGET_ROOTFS_EXT2=y
BR2_TARGET_ROOTFS_EXT2_4=y
BR2_TARGET_ROOTFS_EXT2_SIZE="2G"
BR2_TARGET_ROOTFS_INITRAMFS=y
BR2_TARGET_ARM_TRUSTED_FIRMWARE=y
BR2_TARGET_ARM_TRUSTED_FIRMWARE_PLATFORM="sun50i_h616"
BR2_TARGET_ARM_TRUSTED_FIRMWARE_BL31_UBOOT=y
BR2_TARGET_UBOOT=y
BR2_TARGET_UBOOT_BUILD_SYSTEM_KCONFIG=y
BR2_TARGET_UBOOT_CUSTOM_GIT=y
BR2_TARGET_UBOOT_CUSTOM_REPO_URL="git@github.com:u-boot/u-boot.git"
BR2_TARGET_UBOOT_CUSTOM_REPO_VERSION="0a9a4384c1483a88776bca38e28f09be51161034"
BR2_TARGET_UBOOT_PATCH="$(BR2_EXTERNAL_MANGOPI_MQ_QUAD_PATH)/board/mangopi/patches/u-boot"
BR2_TARGET_UBOOT_USE_CUSTOM_CONFIG=y
BR2_TARGET_UBOOT_CUSTOM_CONFIG_FILE="$(BR2_EXTERNAL_MANGOPI_MQ_QUAD_PATH)/board/mangopi/configs/u-boot.config"
BR2_TARGET_UBOOT_NEEDS_DTC=y
BR2_TARGET_UBOOT_NEEDS_PYLIBFDT=y
BR2_TARGET_UBOOT_NEEDS_ATF_BL31=y
BR2_TARGET_UBOOT_SPL=y
BR2_TARGET_UBOOT_SPL_NAME="u-boot-sunxi-with-spl.bin"
BR2_TARGET_UBOOT_CUSTOM_MAKEOPTS="DEVICE_TREE=sun50i-h616-orangepi-zero2"
BR2_PACKAGE_HOST_DOSFSTOOLS=y
BR2_PACKAGE_HOST_GENIMAGE=y
BR2_PACKAGE_HOST_MTOOLS=y
BR2_PACKAGE_HOST_UBOOT_TOOLS=y
BR2_PACKAGE_HOST_UBOOT_TOOLS_BOOT_SCRIPT=y
BR2_PACKAGE_HOST_UBOOT_TOOLS_BOOT_SCRIPT_SOURCE="$(BR2_EXTERNAL_MANGOPI_MQ_QUAD_PATH)/board/mangopi/configs/boot.cmd"
BR2_PACKAGE_DATETIME_RESTORE=y
BR2_PACKAGE_TELEGRAM_CCTV=y
BR2_PACKAGE_4G_DONGLE=y
```

## configs/mangopi-mq-quad_defconfig
```kconfig
BR2_aarch64=y
BR2_KERNEL_HEADERS_6_1=y
BR2_GCC_VERSION_12_X=y
BR2_TOOLCHAIN_BUILDROOT_CXX=y
BR2_CCACHE=y
BR2_TARGET_GENERIC_HOSTNAME="mangopi"
BR2_TARGET_GENERIC_ISSUE="Welcome to MangoPi MQ-QUAD"
BR2_INIT_OPENRC=y
BR2_ROOTFS_DEVICE_CREATION_DYNAMIC_EUDEV=y
BR2_TARGET_GENERIC_ROOT_PASSWD="1"
BR2_ROOTFS_USERS_TABLES="$(BR2_EXTERNAL_MANGOPI_MQ_QUAD_PATH)/board/mangopi/users.txt"
BR2_ROOTFS_OVERLAY="$(BR2_EXTERNAL_MANGOPI_MQ_QUAD_PATH)/board/mangopi/rootfs-overlay-common"
BR2_ROOTFS_POST_IMAGE_SCRIPT="$(BR2_EXTERNAL_MANGOPI_MQ_QUAD_PATH)/board/mangopi/scripts/prepare_rootfs.sh"
BR2_ROOTFS_POST_SCRIPT_ARGS="${UBOOT_DIR}/u-boot.dtb $(BINARIES_DIR) support/scripts/genimage.sh -c $(BR2_EXTERNAL_MANGOPI_MQ_QUAD_PATH)/board/mangopi/configs/genimage.cfg"
BR2_LINUX_KERNEL=y
BR2_LINUX_KERNEL_CUSTOM_VERSION=y
BR2_LINUX_KERNEL_CUSTOM_VERSION_VALUE="6.12"
BR2_LINUX_KERNEL_PATCH="$(BR2_EXTERNAL_MANGOPI_MQ_QUAD_PATH)/board/mangopi/patches/kernel"
BR2_LINUX_KERNEL_USE_CUSTOM_CONFIG=y
BR2_LINUX_KERNEL_CUSTOM_CONFIG_FILE="$(BR2_EXTERNAL_MANGOPI_MQ_QUAD_PATH)/board/mangopi/configs/kernel.config"
BR2_LINUX_KERNEL_XZ=y
BR2_PACKAGE_LINUX_TOOLS_CPUPOWER=y
BR2_PACKAGE_LINUX_TOOLS_TMON=y
BR2_PACKAGE_GZIP=y
BR2_PACKAGE_XZ=y
BR2_PACKAGE_EXFAT=y
BR2_PACKAGE_EXFAT_UTILS=y
BR2_PACKAGE_EXFATPROGS=y
BR2_PACKAGE_ARMBIAN_FIRMWARE=y
BR2_PACKAGE_I2C_TOOLS=y
BR2_PACKAGE_LM_SENSORS=y
BR2_PACKAGE_LSHW=y
BR2_PACKAGE_LSSCSI=y
BR2_PACKAGE_POWERTOP=y
BR2_PACKAGE_RTL8723DS=y
BR2_PACKAGE_RTL8723DS_BT=y
BR2_PACKAGE_PYTHON3=y
BR2_PACKAGE_CA_CERTIFICATES=y
BR2_PACKAGE_LIBV4L=y
BR2_PACKAGE_LIBCURL=y
BR2_PACKAGE_LIBCURL_CURL=y
BR2_PACKAGE_DHCPCD=y
BR2_PACKAGE_OPENSSH=y
# BR2_PACKAGE_OPENSSH_CLIENT is not set
BR2_PACKAGE_WPA_SUPPLICANT=y
BR2_PACKAGE_HTOP=y
BR2_PACKAGE_LESS=y
BR2_PACKAGE_VIM=y
# BR2_PACKAGE_VIM_RUNTIME is not set
BR2_TARGET_ROOTFS_EXT2=y
BR2_TARGET_ROOTFS_EXT2_4=y
BR2_TARGET_ROOTFS_EXT2_SIZE="1G"
BR2_TARGET_ROOTFS_EXT2_MKFS_OPTIONS="-O ^64bit,dir_index,extent,fast_commit"
BR2_TARGET_ARM_TRUSTED_FIRMWARE=y
BR2_TARGET_ARM_TRUSTED_FIRMWARE_PLATFORM="sun50i_h616"
BR2_TARGET_ARM_TRUSTED_FIRMWARE_BL31_UBOOT=y
BR2_TARGET_UBOOT=y
BR2_TARGET_UBOOT_BUILD_SYSTEM_KCONFIG=y
BR2_TARGET_UBOOT_CUSTOM_VERSION=y
BR2_TARGET_UBOOT_CUSTOM_VERSION_VALUE="2025.01"
BR2_TARGET_UBOOT_PATCH="$(BR2_EXTERNAL_MANGOPI_MQ_QUAD_PATH)/board/mangopi/patches/u-boot"
BR2_TARGET_UBOOT_BOARD_DEFCONFIG="orangepi_zero2"
BR2_TARGET_UBOOT_NEEDS_DTC=y
BR2_TARGET_UBOOT_NEEDS_PYLIBFDT=y
BR2_TARGET_UBOOT_NEEDS_ATF_BL31=y
BR2_TARGET_UBOOT_SPL=y
BR2_TARGET_UBOOT_SPL_NAME="u-boot-sunxi-with-spl.bin"
BR2_PACKAGE_HOST_DOSFSTOOLS=y
BR2_PACKAGE_HOST_GENIMAGE=y
BR2_PACKAGE_HOST_MTOOLS=y
BR2_PACKAGE_HOST_UBOOT_TOOLS=y
BR2_PACKAGE_HOST_UBOOT_TOOLS_BOOT_SCRIPT=y
BR2_PACKAGE_HOST_UBOOT_TOOLS_BOOT_SCRIPT_SOURCE="$(BR2_EXTERNAL_MANGOPI_MQ_QUAD_PATH)/board/mangopi/configs/boot.cmd"
BR2_PACKAGE_DATETIME_RESTORE=y
```

## package/4g-dongle/Config.in
```kconfig
config BR2_PACKAGE_4G_DONGLE
	bool "4G-dongle"
	select BR2_PACKAGE_IW
	select BR2_PACKAGE_HOSTAPD
	select BR2_PACKAGE_DNSMASQ
	select BR2_PACKAGE_NGINX
	help
		Daemon that creates reverse-proxy on wlan0 for web interface
		of 4G dongle
```

## package/Config.in
```kconfig
source "$BR2_EXTERNAL_MANGOPI_MQ_QUAD_PATH/package/datetime-restore/Config.in"
source "$BR2_EXTERNAL_MANGOPI_MQ_QUAD_PATH/package/telegram-cctv/Config.in"
source "$BR2_EXTERNAL_MANGOPI_MQ_QUAD_PATH/package/4g-dongle/Config.in"
```

## package/alcatel-dongle/Config.in
```kconfig
config BR2_PACKAGE_ALCATEL_DONGLE
	bool "alcatel-dongle"
	select BR2_PACKAGE_IW
	select BR2_PACKAGE_HOSTAPD
	select BR2_PACKAGE_DNSMASQ
	select BR2_PACKAGE_TINYPROXY
	help
		Daemon that creates reverse-proxy on wlan0 for web interface
		of alcatel dongle
```

## package/datetime-restore/Config.in
```kconfig
config BR2_PACKAGE_DATETIME_RESTORE
	bool "datetime-restore"
	help
		Daemon that saves current datetime to file, so it could be
		loaded on next boot
```

## package/gitea-docker/Config.in
```kconfig
config BR2_PACKAGE_GITEA_DOCKER
	bool "gitea-docker"
	select BR2_PACKAGE_DOCKER_COMPOSE
	select BR2_PACKAGE_DOCKER_ENGINE
	help
		Docker-compose file to bring up self-hosted gitea instance
```

## package/telegram-cctv/Config.in
```kconfig
config BR2_PACKAGE_TELEGRAM_CCTV
	bool "telegram-cctv"
	select BR2_PACKAGE_LIBCURL
	help
		Implements capturing photos from video-device via v4l2 and sending
		them to telegram channel
```
